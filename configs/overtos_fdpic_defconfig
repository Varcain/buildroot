## configs/stm32f746_disco_hammer_qspi_xip_maintenance_defconfig
```kconfig
BR2_arm=y
BR2_cortex_m7=y
BR2_BINFMT_FDPIC=y
BR2_PACKAGE_HOST_LINUX_HEADERS_CUSTOM_5_15=y
BR2_TOOLCHAIN_BUILDROOT_WCHAR=y
BR2_GLOBAL_PATCH_DIR="board/stmicroelectronics/stm32f746-disco/patches board/stmicroelectronics/stm32f746-disco/hammer/patches board/stmicroelectronics/stm32f746-disco/qspi/patches"
BR2_DOWNLOAD_FORCE_CHECK_HASHES=y
BR2_TARGET_GENERIC_ROOT_PASSWD="root"
# BR2_TARGET_GENERIC_REMOUNT_ROOTFS_RW is not set
BR2_ROOTFS_OVERLAY="board/stmicroelectronics/stm32f746-disco/hammer/rootfs-overlay board/stmicroelectronics/stm32f746-disco/hammer/maintenance-overlay"
BR2_ROOTFS_POST_BUILD_SCRIPT="board/stmicroelectronics/stm32f746-disco/hammer/post-build.sh board/stmicroelectronics/stm32f746-disco/qspi/post-build.sh"
BR2_LINUX_KERNEL=y
BR2_LINUX_KERNEL_CUSTOM_VERSION=y
BR2_LINUX_KERNEL_CUSTOM_VERSION_VALUE="5.15.211"
BR2_LINUX_KERNEL_DEFCONFIG="stm32"
BR2_LINUX_KERNEL_CONFIG_FRAGMENT_FILES="board/stmicroelectronics/stm32f746-disco/linux.fragment board/stmicroelectronics/stm32f746-disco/hammer/linux.fragment board/stmicroelectronics/stm32f746-disco/qspi/linux.fragment board/stmicroelectronics/stm32f746-disco/hammer/qspi-xip.fragment"
BR2_LINUX_KERNEL_IMAGE_TARGET_CUSTOM=y
BR2_LINUX_KERNEL_IMAGE_TARGET_NAME="xipImage"
BR2_LINUX_KERNEL_DTS_SUPPORT=y
BR2_LINUX_KERNEL_CUSTOM_DTS_PATH="board/stmicroelectronics/stm32f746-disco/hammer/stm32f746-disco-hammer.dts"
BR2_LINUX_KERNEL_INSTALL_TARGET=y
BR2_PACKAGE_BUSYBOX_CONFIG_FRAGMENT_FILES="board/stmicroelectronics/stm32f746-disco/hammer/busybox.fragment"
BR2_PACKAGE_DOSFSTOOLS=y
# BR2_PACKAGE_DOSFSTOOLS_ICONV is not set
BR2_PACKAGE_DOSFSTOOLS_FSCK_FAT=y
BR2_TARGET_ROOTFS_CRAMFS=y
BR2_TARGET_ROOTFS_CRAMFS_XIP=y
# BR2_TARGET_ROOTFS_TAR is not set
```

## configs/stm32f746_disco_hammer_qspi_xip_preempt_rt_defconfig
```kconfig
BR2_arm=y
BR2_cortex_m7=y
BR2_BINFMT_FDPIC=y
BR2_PACKAGE_HOST_LINUX_HEADERS_CUSTOM_5_15=y
BR2_GLOBAL_PATCH_DIR="board/stmicroelectronics/stm32f746-disco/hammer/preempt-rt-patches board/stmicroelectronics/stm32f746-disco/patches board/stmicroelectronics/stm32f746-disco/hammer/patches board/stmicroelectronics/stm32f746-disco/qspi/patches"
BR2_DOWNLOAD_FORCE_CHECK_HASHES=y
BR2_TARGET_GENERIC_ROOT_PASSWD="root"
# BR2_TARGET_GENERIC_REMOUNT_ROOTFS_RW is not set
BR2_ROOTFS_OVERLAY="board/stmicroelectronics/stm32f746-disco/hammer/rootfs-overlay"
BR2_ROOTFS_POST_BUILD_SCRIPT="board/stmicroelectronics/stm32f746-disco/hammer/post-build.sh board/stmicroelectronics/stm32f746-disco/qspi/post-build.sh"
BR2_ROOTFS_POST_IMAGE_SCRIPT="board/stmicroelectronics/stm32f746-disco/hammer/post-image-qspi-xip.sh"
BR2_LINUX_KERNEL=y
BR2_LINUX_KERNEL_CUSTOM_VERSION=y
BR2_LINUX_KERNEL_CUSTOM_VERSION_VALUE="5.15.211"
BR2_LINUX_KERNEL_DEFCONFIG="stm32"
BR2_LINUX_KERNEL_CONFIG_FRAGMENT_FILES="board/stmicroelectronics/stm32f746-disco/linux.fragment board/stmicroelectronics/stm32f746-disco/hammer/linux.fragment board/stmicroelectronics/stm32f746-disco/qspi/linux.fragment board/stmicroelectronics/stm32f746-disco/hammer/qspi-xip.fragment board/stmicroelectronics/stm32f746-disco/hammer/linux-preempt-rt.fragment"
BR2_LINUX_KERNEL_IMAGE_TARGET_CUSTOM=y
BR2_LINUX_KERNEL_IMAGE_TARGET_NAME="xipImage"
BR2_LINUX_KERNEL_DTS_SUPPORT=y
BR2_LINUX_KERNEL_CUSTOM_DTS_PATH="board/stmicroelectronics/stm32f746-disco/hammer/stm32f746-disco-hammer.dts"
BR2_LINUX_KERNEL_INSTALL_TARGET=y
BR2_PACKAGE_BUSYBOX_CONFIG_FRAGMENT_FILES="board/stmicroelectronics/stm32f746-disco/hammer/busybox.fragment"
BR2_PACKAGE_SQLITE=y
BR2_PACKAGE_DROPBEAR=y
# BR2_PACKAGE_DROPBEAR_CLIENT is not set
BR2_PACKAGE_DROPBEAR_DISABLE_REVERSEDNS=y
BR2_PACKAGE_DROPBEAR_LOCALOPTIONS_FILE="board/stmicroelectronics/stm32f746-disco/qspi/dropbear-localoptions.h"
BR2_PACKAGE_NATIVE_LINUX_HAMMER=y
BR2_TARGET_ROOTFS_CRAMFS=y
BR2_TARGET_ROOTFS_CRAMFS_XIP=y
# BR2_TARGET_ROOTFS_TAR is not set
BR2_TARGET_UBOOT=y
BR2_TARGET_UBOOT_BUILD_SYSTEM_KCONFIG=y
BR2_TARGET_UBOOT_CUSTOM_VERSION=y
BR2_TARGET_UBOOT_CUSTOM_VERSION_VALUE="2026.07"
BR2_TARGET_UBOOT_BOARD_DEFCONFIG="stm32f746-disco"
BR2_TARGET_UBOOT_DEFAULT_ENV_FILE="board/stmicroelectronics/stm32f746-disco/hammer/qspi-xip-uboot-env.txt"
BR2_TARGET_UBOOT_NEEDS_OPENSSL=y
BR2_PACKAGE_HOST_OPENOCD=y
```

## configs/stm32f746_disco_internal_xip_defconfig
```kconfig
BR2_arm=y
BR2_cortex_m7=y
BR2_BINFMT_FDPIC=y
BR2_PACKAGE_HOST_LINUX_HEADERS_CUSTOM_5_15=y
BR2_GLOBAL_PATCH_DIR="board/stmicroelectronics/stm32f746-disco/patches board/stmicroelectronics/stm32f746-disco/hammer/patches"
BR2_DOWNLOAD_FORCE_CHECK_HASHES=y
BR2_LINUX_KERNEL=y
BR2_LINUX_KERNEL_CUSTOM_VERSION=y
BR2_LINUX_KERNEL_CUSTOM_VERSION_VALUE="5.15.211"
BR2_LINUX_KERNEL_DEFCONFIG="stm32"
BR2_LINUX_KERNEL_CONFIG_FRAGMENT_FILES="board/stmicroelectronics/stm32f746-disco/linux.fragment board/stmicroelectronics/stm32f746-disco/hammer/linux.fragment board/stmicroelectronics/stm32f746-disco/qspi/linux.fragment board/stmicroelectronics/stm32f746-disco/qspi/internal-xip.fragment"
BR2_LINUX_KERNEL_IMAGE_TARGET_CUSTOM=y
BR2_LINUX_KERNEL_IMAGE_TARGET_NAME="xipImage"
BR2_LINUX_KERNEL_DTS_SUPPORT=y
BR2_LINUX_KERNEL_CUSTOM_DTS_PATH="board/stmicroelectronics/stm32f746-disco/hammer/stm32f746-disco-hammer.dts board/stmicroelectronics/stm32f746-disco/qspi/stm32f746-disco-qspi.dts"
BR2_ROOTFS_POST_IMAGE_SCRIPT="board/stmicroelectronics/stm32f746-disco/qspi/report-internal-xip.sh"
# BR2_TARGET_ROOTFS_TAR is not set
```

## package/lua-ove-process/Config.in
```kconfig
config BR2_PACKAGE_LUA_OVE_PROCESS
	bool "lua-ove-process"
	help
	  Small NOMMU-safe process-control module for Lua. It exposes
	  posix_spawnp(), waitpid(), kill(), getpriority(), and setpriority()
	  without relying on fork() or a shell.
```

## package/micropython/Config.in
```kconfig
config BR2_PACKAGE_MICROPYTHON
	bool "micropython"
	depends on BR2_TOOLCHAIN_HAS_THREADS
	depends on !BR2_STATIC_LIBS
	help
	  MicroPython is a lean and fast implementation of the Python
	  3 programming language that is optimised to run on a
	  microcontroller.

	  https://micropython.org

if BR2_PACKAGE_MICROPYTHON

config BR2_PACKAGE_MICROPYTHON_LIB
	bool "micropython-lib"
	help
	  Core Python libraries ported to MicroPython.

	  This contains compatible but reduced-functionality versions
	  of some Python standard library and wider Python ecosystem
	  modules, as well as some MicroPython-specific libraries
	  that aren't included in the base package.

config BR2_PACKAGE_MICROPYTHON_SQLITE
	bool "sqlite3 module"
	select BR2_PACKAGE_SQLITE
	help
	  Build a small native sqlite3 module into the interpreter. The module
	  exposes connect(), Connection.execute(), Connection.scalar() and
	  Connection.close(), and does not depend on the Unix FFI module.

	  This is suitable for FDPIC targets, where indirect calls through the
	  Unix FFI are not ABI-safe.

if BR2_PACKAGE_MICROPYTHON_LIB

config BR2_PACKAGE_MICROPYTHON_LIB_UNIXFFI
	bool "micropython-lib unix-ffi modules"
	default y
	depends on !BR2_BINFMT_FDPIC
	select BR2_PACKAGE_LIBFFI
	select BR2_PACKAGE_PCRE2 # runtime
	help
	  Unix-specific MicroPython packages

	  These provide additional functionality to MicroPython in
	  standard environments.

comment "micropython-lib unix-ffi modules need a non-FDPIC toolchain"
	depends on BR2_BINFMT_FDPIC

endif # BR2_PACKAGE_MICROPYTHON_LIB

endif # BR2_PACKAGE_MICROPYTHON

comment "micropython needs a toolchain w/ threads, dynamic library"
	depends on !BR2_TOOLCHAIN_HAS_THREADS || BR2_STATIC_LIBS
```

## package/native-linux-hammer/Config.in
```kconfig
config BR2_PACKAGE_NATIVE_LINUX_HAMMER
	bool "native-linux-hammer"
	depends on !BR2_USE_MMU
	select BR2_PACKAGE_SQLITE
	help
	  Native Linux implementation of the STM32F746 hammer workload.

	  It provides the LVGL 9.5 music demo, Linux uinput automation,
	  an absolute-clock SCHED_FIFO latency probe, and the five-minute
	  SQLite/network/display benchmark driver.
```

## package/overtos-lvbench/Config.in
```kconfig
config BR2_PACKAGE_OVERTOS_LVBENCH
	bool "overtos-lvbench (LVGL fbdev benchmark)"
	help
	  lv_demo_benchmark built against LVGL's Linux fbdev driver as a static
	  FDPIC binary (/usr/bin/lvbench) for the oveRTOS Linux personality — it
	  renders to /dev/fb0. Needs the personality's framebuffer device
	  (CONFIG_OVE_LINUX_DEV_FB on the oveRTOS side).

	  https://lvgl.io
```
